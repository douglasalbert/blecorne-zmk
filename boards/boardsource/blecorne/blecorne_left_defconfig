## boards/boardsource/blecorne/blecorne_left_defconfig
```kconfig
#
# Copyright (c) 2024 Kyle Brown
# SPDX-License-Identifier: MIT
#

# Enable MPU
CONFIG_ARM_MPU=y

# Enable pinctrl
CONFIG_PINCTRL=y

# Enable GPIO
CONFIG_GPIO=y

# Enable SPI
CONFIG_SPI_NRFX=y

# Enable writing to flash
CONFIG_USE_DT_CODE_PARTITION=y
CONFIG_BUILD_OUTPUT_UF2=y
CONFIG_MPU_ALLOW_FLASH_WRITE=y
CONFIG_NVS=y
CONFIG_SETTINGS_NVS=y
CONFIG_FLASH=y
CONFIG_FLASH_PAGE_LAYOUT=y
CONFIG_FLASH_MAP=y

# Enable 32kHz crystal
CONFIG_CLOCK_CONTROL_NRF_K32SRC_XTAL=y
CONFIG_CLOCK_CONTROL_NRF_K32SRC_30PPM=y

# Enable USB & Studio on left half
CONFIG_ZMK_USB=y
CONFIG_ZMK_STUDIO=y
CONFIG_ZMK_STUDIO_LOCKING=n

CONFIG_ZMK_BLE=y
CONFIG_ZMK_SLEEP=y

# Enable status advertisement (central only - requires modifiers events)
CONFIG_ZMK_STATUS_ADVERTISEMENT=y
CONFIG_ZMK_STATUS_ADV_KEYBOARD_NAME="blecorne"
CONFIG_ZMK_SPLIT_BLE_CENTRAL_BATTERY_LEVEL_FETCHING=y
```

## boards/shields/blecorne_dongle/Kconfig.defconfig
```kconfig
#
# Copyright (c) 2024 Kyle Brown
# SPDX-License-Identifier: MIT
#

if SHIELD_BLECORNE_DONGLE

config ZMK_KEYBOARD_NAME
	default "BLE Corne"

config ZMK_SPLIT_ROLE_CENTRAL
	default y

config ZMK_SPLIT
	default y

config ZMK_USB
	default y

config ZMK_BLE
	default y

endif
```

## boards/shields/blecorne_dongle/Kconfig.shield
```kconfig
#
# Copyright (c) 2024 Kyle Brown
# SPDX-License-Identifier: MIT
#

config SHIELD_BLECORNE_DONGLE
	def_bool $(shields_list_contains,blecorne_dongle)
```
